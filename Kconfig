## secure_fw/spm/Kconfig
```kconfig
#-------------------------------------------------------------------------------
# Copyright (c) 2022-2023, Arm Limited. All rights reserved.
#
# SPDX-License-Identifier: BSD-3-Clause
#
#-------------------------------------------------------------------------------

menu "SPM"
config TFM_ISOLATION_LEVEL
    int "Isolation level"
    default 1
    range 1 1 if CONFIG_TFM_SPM_BACKEND_SFN
    range 1 3 if PLATFORM_HAS_ISOLATION_L3_SUPPORT
    range 1 2

choice
    prompt "SPM Backend"
    default CONFIG_TFM_SPM_BACKEND_SFN

    config CONFIG_TFM_SPM_BACKEND_SFN
        bool "SFN Backend"

    config CONFIG_TFM_SPM_BACKEND_IPC
        bool "IPC Backend"
        select CONFIG_TFM_PARTITION_META
endchoice

config CONFIG_TFM_SPM_BACKEND
    string
    default "IPC" if CONFIG_TFM_SPM_BACKEND_IPC
    default "SFN" if CONFIG_TFM_SPM_BACKEND_SFN
    default ""

choice
    prompt "Fault injection hardening profile"

    config TFM_FIH_PROFILE_OFF
        bool "OFF"

    config TFM_FIH_PROFILE_LOW
        bool "Low"

    config TFM_FIH_PROFILE_MEDIUM
        bool "Medium"

    config TFM_FIH_PROFILE_HIGH
        bool "High"
endchoice

config TFM_FIH_PROFILE
    string
    default "OFF" if TFM_FIH_PROFILE_OFF
    default "LOW" if TFM_FIH_PROFILE_LOW
    default "MEDIUM" if TFM_FIH_PROFILE_MEDIUM
    default "HIGH" if TFM_FIH_PROFILE_HIGH

config PSA_FRAMEWORK_HAS_MM_IOVEC
    bool "Enable MM-IOVEC"
    default n
    depends on TFM_ISOLATION_LEVEL = 1
endmenu

######################## Promptless (non-user) config options ##################
########### Do NOT change the following config options anywhere! ###############
config CONFIG_TFM_PARTITION_META
    def_bool n

config TFM_PARTITION_NS_AGENT_MAILBOX
    bool
    default y if TFM_MULTI_CORE_TOPOLOGY
    default n

config TFM_PARTITION_NS_AGENT_TZ
    bool
    default y if CONFIG_TFM_USE_TRUSTZONE
    default n
```

## west.yml
```yaml
# The west manifest file (west.yml) for the Zephyr Trusted Firmware-M module.
#
# This file specifies dependencies of TF-M, as can also be found referenced in
# the trusted-firmware-m build system.

manifest:
  projects:
    - name: tfm-mcuboot
      url: https://github.com/zephyrproject-rtos/mcuboot
      path: modules/tee/tfm-mcuboot
      revision: 1.7.0-rc1
```
