## Kconfig
```kconfig
menuconfig TFM
	bool "Build with TFM"

if TFM
config TFM_BOARD
	string
	default "nordic_nrf/nrf9160dk_nrf9160" if BOARD_NRF9160DK_NRF9160NS
	default "nordic_nrf/nrf5340pdk_nrf5340_cpuapp" if BOARD_NRF5340PDK_NRF5340_CPUAPPNS
config TFM_IPC
	bool "IPC"
config TFM_REGRESSION
	bool "Regression tests"
config TFM_BL2
	bool "Build with MCUboot"
	default y

config TFM_PSA_TEST_CRYPTO
	bool "Crypto tests"
config TFM_PSA_TEST_STORAGE
	bool "Storage tests"
config TFM_PSA_TEST_INITIAL_ATTESTATION
	bool "Initial attestation tests"
endif
```

## config/build_type/Kconfig.debug
```kconfig
#-------------------------------------------------------------------------------
# Copyright (c) 2023, Arm Limited. All rights reserved.
#
# SPDX-License-Identifier: BSD-3-Clause
#
#-------------------------------------------------------------------------------

config MBEDCRYPTO_BUILD_TYPE
    default "relwithdebinfo"

config BL1_2_BUILD_TYPE
    default "relwithdebinfo"

config TFM_SPM_LOG_LEVEL
    default 3

config TFM_PARTITION_LOG_LEVEL
    default 3

config CONFIG_TFM_HALT_ON_CORE_PANIC
    default y
```

## config/build_type/Kconfig.minsizerel
```kconfig
#-------------------------------------------------------------------------------
# Copyright (c) 2023, Arm Limited. All rights reserved.
#
# SPDX-License-Identifier: BSD-3-Clause
#
#-------------------------------------------------------------------------------

if BL2
config MCUBOOT_LOG_LEVEL
    default "OFF"
endif

choice SPM_LOG_LEVEL
    default SPM_LOG_LEVEL_SILENCE
endchoice

choice PARTITION_LOG_LEVEL
    default PARTITION_LOG_LEVEL_SILENCE
endchoice
```

## config/build_type/Kconfig.release
```kconfig
#-------------------------------------------------------------------------------
# Copyright (c) 2023, Arm Limited. All rights reserved.
#
# SPDX-License-Identifier: BSD-3-Clause
#
#-------------------------------------------------------------------------------

config MBEDCRYPTO_BUILD_TYPE
    default "minsizerel"

config BL1_2_BUILD_TYPE
    default "minsizerel"

if BL2
config MCUBOOT_LOG_LEVEL
    default "OFF"
endif

config TFM_SPM_LOG_LEVEL
    default 0

config TFM_PARTITION_LOG_LEVEL
    default 0

if BL1 && PLATFORM_DEFAULT_BL1
config TFM_BL1_LOGGING
    default n
endif
```

## lib/ext/psa_arch_tests/Kconfig
```kconfig
#-------------------------------------------------------------------------------
# Copyright (c) 2022, Arm Limited. All rights reserved.
#
# SPDX-License-Identifier: BSD-3-Clause
#
#-------------------------------------------------------------------------------

menu "PSA Arch Test"

choice
    prompt "Which (if any) of the PSA API tests should be compiled"
    depends on !(TFM_S_REG_TEST || TFM_NS_REG_TEST)

    config TEST_PSA_API_NONE
        bool "None"

    config TEST_PSA_API_IPC
        bool "IPC"

    config TEST_PSA_API_CRYPTO
        bool "Crypto"
        depends on TFM_PARTITION_CRYPTO

    config TEST_PSA_API_INITIAL_ATTESTATION
        bool "Initial attestation"
        depends on TFM_PARTITION_INITIAL_ATTESTATION

    config TEST_PSA_API_INTERNAL_TRUSTED_STORAGE
        bool "Internal trusted storage"
        depends on TFM_PARTITION_INTERNAL_TRUSTED_STORAGE

    config TEST_PSA_API_PROTECTED_STORAGE
        bool "Protected storage"
        depends on TFM_PARTITION_PROTECTED_STORAGE

    config TEST_PSA_API_STORAGE
        bool "Storage(ITS+PS)"
        depends on TFM_PARTITION_INTERNAL_TRUSTED_STORAGE && TFM_PARTITION_PROTECTED_STORAGE

endchoice

config TEST_PSA_API
    string
    depends on !(TFM_S_REG_TEST || TFM_NS_REG_TEST)
    default "" if TEST_PSA_API_NONE
    default "IPC" if TEST_PSA_API_IPC
    default "CRYPTO" if TEST_PSA_API_CRYPTO
    default "INITIAL_ATTESTATION" if TEST_PSA_API_INITIAL_ATTESTATION
    default "INTERNAL_TRUSTED_STORAGE" if TEST_PSA_API_INTERNAL_TRUSTED_STORAGE
    default "PROTECTED_STORAGE" if TEST_PSA_API_PROTECTED_STORAGE
    default "STORAGE" if TEST_PSA_API_STORAGE
    default ""

endmenu
```

## lib/ext/tf-m-tests/Kconfig
```kconfig
#-------------------------------------------------------------------------------
# Copyright (c) 2022, Arm Limited. All rights reserved.
#
# SPDX-License-Identifier: BSD-3-Clause
#
#-------------------------------------------------------------------------------

menu "TF-M regression tests"

config TEST_S
    bool "Enable default secure test cases"
    default n
    imply TEST_S_ATTESTATION
    imply TEST_S_CRYPTO
    imply TEST_S_ITS
    imply TEST_S_PS
    imply TEST_S_PLATFORM
    imply TEST_S_FWU
    imply TEST_S_SFN_BACKEND

config TEST_NS
    bool "Enable default non-secure test cases"
    depends on NS
    default n
    imply TEST_NS_ATTESTATION
    imply TEST_NS_T_COSE
    imply TEST_NS_QCBOR
    imply TEST_NS_CRYPTO
    imply TEST_NS_PS
    imply TEST_NS_ITS
    imply TEST_NS_PLATFORM
    imply TEST_NS_FWU
    imply TEST_NS_MULTI_CORE
    imply TEST_NS_MANAGE_NSID
    imply TEST_NS_IPC
    imply TEST_NS_SFN_BACKEND

################################# Secure test ##################################

menu "Secure regression tests"

config TEST_S_ATTESTATION
    bool "Attestation"
    depends on TFM_PARTITION_INITIAL_ATTESTATION

config TEST_S_CRYPTO
    bool "Crypto"
    depends on TFM_PARTITION_CRYPTO

config TEST_S_ITS
    bool "ITS"
    depends on TFM_PARTITION_INTERNAL_TRUSTED_STORAGE

config TEST_S_PS
    bool "PS"
    depends on TFM_PARTITION_PROTECTED_STORAGE

config TEST_S_PLATFORM
    bool "Platform"
    depends on TFM_PARTITION_PLATFORM

config TEST_S_FWU
    bool "FWU"
    depends on TFM_PARTITION_FIRMWARE_UPDATE

config TEST_S_IPC
    bool "IPC"
    depends on TFM_SPM_BACKEND_IPC

config TEST_S_SFN_BACKEND
    bool "SFN backend"
    depends on TFM_SPM_BACKEND_SFN

config TEST_S_FPU
    bool "FPU"
    default n
endmenu

################################# Non-secure test ##############################

menu "Non-Secure regression tests"
    depends on NS

config TEST_NS_ATTESTATION
    bool "Attestation"
    depends on TFM_PARTITION_INITIAL_ATTESTATION

config TEST_NS_T_COSE
    bool "t_cose"
    depends on TFM_PARTITION_INITIAL_ATTESTATION && !SYMMETRIC_INITIAL_ATTESTATION

config TEST_NS_QCBOR
    bool "QCBOR"
    depends on TFM_PARTITION_INITIAL_ATTESTATION

config TEST_NS_CRYPTO
    bool "Crypto"
    depends on TFM_PARTITION_CRYPTO

comment "PS NS test depends on partition ITS and PS, and NS ITS test"
    depends on !(TFM_PARTITION_PROTECTED_STORAGE && TEST_NS_ITS)

config TEST_NS_PS
    bool "PS"
    depends on TFM_PARTITION_PROTECTED_STORAGE && TEST_NS_ITS

config TEST_NS_ITS
    bool "ITS"
    depends on TFM_PARTITION_INTERNAL_TRUSTED_STORAGE

config TEST_NS_PLATFORM
    bool "Platform"
    depends on TFM_PARTITION_PLATFORM

config TEST_NS_FWU
    bool "FWU"
    depends on TFM_PARTITION_FIRMWARE_UPDATE

config TEST_NS_MULTI_CORE
    bool "Multi-core"
    depends on TFM_MULTI_CORE_TOPOLOGY

config TEST_NS_MANAGE_NSID
    bool "NSID management"
    depends on TFM_NS_MANAGE_NSID

choice TEST_NS_IRQ
    prompt "IRQ test type"
    default TEST_NS_NONE_IRQ

    config TEST_NS_NONE_IRQ
        bool "None IRQ test"

    # Make FLIH IRQ test as the default IRQ test
    config TEST_NS_FLIH_IRQ
        bool "First-Level Interrupt Handling"

    config TEST_NS_SLIH_IRQ
        bool "Second-Level Interrupt Handling"

endchoice

config TEST_NS_FPU
    bool "FPU"
    default n

config TEST_NS_IPC
    bool "IPC"
    depends on CONFIG_TFM_SPM_BACKEND_IPC

config TEST_NS_SFN_BACKEND
    bool "SFN backend"
    depends on CONFIG_TFM_SPM_BACKEND_SFN

endmenu

################################# Crypto tests #################################

if TEST_NS_CRYPTO || TEST_S_CRYPTO

menu "Crypto Test Configs"

config TFM_CRYPTO_TEST_ALG_CBC
    bool "Test CBC cryptography mode"
    default y

config TFM_CRYPTO_TEST_ALG_CCM
    bool "Test CCM cryptography mode"
    default y

config TFM_CRYPTO_TEST_ALG_CFB
    bool "Test CFB cryptography mode"
    default y

config TFM_CRYPTO_TEST_ALG_ECB
    bool "Test ECB cryptography mode"
    default y

config TFM_CRYPTO_TEST_ALG_CTR
    bool "Test CTR cryptography mode"
    default y

config TFM_CRYPTO_TEST_ALG_OFB
    bool "Test OFB cryptography mode"
    default y

config TFM_CRYPTO_TEST_ALG_GCM
    bool "Test GCM cryptography mode"
    default y

config TFM_CRYPTO_TEST_ALG_SHA_384
    bool "Test SHA-384 cryptography algorithm"
    default y

config TFM_CRYPTO_TEST_ALG_SHA_512
    bool "Test SHA-512 cryptography algorithm"
    default y

config TFM_CRYPTO_TEST_HKDF
    bool "Test the HKDF key derivation algorithm"
    default y

config TFM_CRYPTO_TEST_ECDH
    bool "Test the ECDH key agreement algorithm"
    default y

config TFM_CRYPTO_TEST_CHACHA20
    bool "Test the ChaCha20 stream cipher"
    default n

config TFM_CRYPTO_TEST_ALG_CHACHA20_POLY1305
    bool "Test ChaCha20-Poly1305 AEAD algorithm"
    default n

config TFM_CRYPTO_TEST_SINGLE_PART_FUNCS
    bool "Test single-part operations in hash, MAC, AEAD and symmetric ciphers"
    default y

endmenu
endif
endmenu
```

## platform/ext/target/nxp/frdmmcxa577/Native_Driver/drivers/Kconfig
```kconfig
# Copyright 2025 NXP
#
# SPDX-License-Identifier: BSD-3-Clause

menu "Device specific drivers configuration"

    rsource "romapi/Kconfig"

    config MCUX_COMPONENT_driver.clock
         bool "clock"
         default y

    config MCUX_COMPONENT_driver.edma_soc
         bool "edma_soc"
         default n

    config MCUX_COMPONENT_driver.inputmux_connections
         bool "inputmux_connections"
         default y

    config MCUX_COMPONENT_driver.reset
         bool "reset"
         default y

    config MCUX_COMPONENT_driver.trdc_soc
         bool "trdc_soc"
         default n

endmenu
```

## platform/ext/target/nxp/frdmmcxa577/Native_Driver/drivers/romapi/Kconfig
```kconfig
# Copyright 2025 NXP
#
# SPDX-License-Identifier: BSD-3-Clause

config MCUX_HAS_COMPONENT_driver.romapi
    bool
    default y

config MCUX_COMPONENT_driver.romapi
    bool "romapi"
    select MCUX_COMPONENT_driver.common
    select MCUX_COMPONENT_driver.romapi_nboot
    select MCUX_COMPONENT_driver.romapi_runbootloader
    select MCUX_COMPONENT_driver.romapi_flashiap
    depends on MCUX_HAS_COMPONENT_driver.romapi


config MCUX_COMPONENT_driver.romapi_nboot
    bool "romapi_nboot"
    select MCUX_COMPONENT_driver.common
    depends on MCUX_HAS_COMPONENT_driver.romapi

config MCUX_COMPONENT_driver.romapi_runbootloader
    bool "romapi_runbootloader"
    select MCUX_COMPONENT_driver.common
    depends on MCUX_HAS_COMPONENT_driver.romapi

config MCUX_COMPONENT_driver.romapi_flashiap
    bool "romapi_flashiap"
    select MCUX_COMPONENT_driver.common
    depends on MCUX_HAS_COMPONENT_driver.romapi
```

## secure_fw/partitions/Kconfig
```kconfig
#-------------------------------------------------------------------------------
# Copyright (c) 2022, Arm Limited. All rights reserved.
#
# SPDX-License-Identifier: BSD-3-Clause
#
#-------------------------------------------------------------------------------

menu "Secure partitions"
config TFM_PARTITION_CRYPTO
    bool "Crypto"
    default y

if TFM_PARTITION_CRYPTO

    config CRYPTO_HW_ACCELERATOR
        bool "Enable the crypto hardware accelerator"
        default n

    config CRYPTO_TFM_BUILTIN_KEYS_DRIVER
        bool "Allow crypto service to store builtin keys"
        default y
        help
          Whether to allow crypto service to store builtin keys. Without this,
          all builtin keys must be stored in a platform-specific location.
endif

config TFM_PARTITION_INITIAL_ATTESTATION
    bool "Initial attestation"
    default y

config TFM_PARTITION_INTERNAL_TRUSTED_STORAGE
    bool "Internal Trusted Storage"
    default y

config TFM_PARTITION_PLATFORM
    bool "Platform"
    default y

comment "Firmware update depends on partition Platform"
    depends on !TFM_PARTITION_PLATFORM

config TFM_PARTITION_FIRMWARE_UPDATE
    bool "Firmware update"
    default n
    depends on TFM_PARTITION_PLATFORM

comment "Protected Storage depends on partition ITS and Platform"
    depends on !(TFM_PARTITION_INTERNAL_TRUSTED_STORAGE && TFM_PARTITION_PLATFORM)

config TFM_PARTITION_PROTECTED_STORAGE
    bool "Protected Storage"
    default y
    depends on TFM_PARTITION_INTERNAL_TRUSTED_STORAGE && TFM_PARTITION_PLATFORM
    help
      PS only uses the platform partition when PS_ROLLBACK_PROTECTION is ON,
      but the dependency in the manifest file means the dependency is
      unconditional.
endmenu
```

## secure_fw/partitions/initial_attestation/Kconfig
```kconfig
#-------------------------------------------------------------------------------
# SPDX-FileCopyrightText: Copyright The TrustedFirmware-M Contributors
# SPDX-License-Identifier: BSD-3-Clause
#
#-------------------------------------------------------------------------------

menuconfig TFM_PARTITION_INITIAL_ATTESTATION
    bool "Initial attestation"
    depends on TFM_PARTITION_CRYPTO
    default n

if TFM_PARTITION_INITIAL_ATTESTATION

config SYMMETRIC_INITIAL_ATTESTATION
    bool "Symmetric key algorithm based Initial Attestation"
    default n
    help
      Use symmetric crypto for initial attestation

config ATTEST_KEY_BITS
    int "Key bit width"
    default 256
    help
      The size of the initial attestation key in bits

config PSA_INITIAL_ATTEST_MAX_TOKEN_SIZE
    hex  "The maximum possible size of a token"
    default 0x250

endif
```

## secure_fw/partitions/proof_of_execution/Kconfig
```kconfig
#-------------------------------------------------------------------------------
# Copyright (c) 2023, Arm Limited. All rights reserved.
#
# SPDX-License-Identifier: BSD-3-Clause
#
#-------------------------------------------------------------------------------

menuconfig TFM_PARTITION_POX
    bool "POX secure partition"
    default n
```

## secure_fw/partitions/protected_storage/Kconfig
```kconfig
#-------------------------------------------------------------------------------
# Copyright (c) 2023, Arm Limited. All rights reserved.
# Copyright (c) 2024 Cypress Semiconductor Corporation (an Infineon company)
# or an affiliate of Cypress Semiconductor Corporation. All rights reserved.
#
# SPDX-License-Identifier: BSD-3-Clause
#
#-------------------------------------------------------------------------------

menuconfig TFM_PARTITION_PROTECTED_STORAGE
    bool "Protected Storage"
    depends on TFM_PARTITION_PLATFORM && TFM_PARTITION_CRYPTO
    default n

if TFM_PARTITION_PROTECTED_STORAGE

config PS_ENCRYPTION
    bool "PS encryption"
    default y
    help
      Enable encryption option to encrypt the protected storage data.

config PS_CRYPTO_AEAD_ALG
    string "PS encryption AEAD algorithm"
    default "PSA_ALG_GCM"
    help
      Indicates the AEAD algorithm to use for authenticated encryption in
      Protected Storage.

      Note: For GCM/CCM it is essential that IV doesn't get repeated. If this
      flag is set to PSA_ALG_GCM or PSA_ALG_CCM, PS_ROLLBACK_PROTECTION must be
      enabled to protect against IV rollback.

config PS_AES_KEY_USAGE_LIMIT
    string "Number of blocks to use a key for before changing it. 0 for no limit"
    depends on PS_ENCRYPTION
    default "0"
    help
      If this value is non-zero, PS will not use any given key to encrypt/decrypt
      more than the specified number of blocks.

      Note: If this is set too low, it will limit the maximum size of objects that
      can be stored in PS, because the system will reject object that are too large
      to be encrypted and then decrypted again without hitting this limit.
endif
```
